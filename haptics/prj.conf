## CMakeLists.txt
```
cmake_minimum_required(VERSION 3.20.0)

find_package(Zephyr REQUIRED HINTS $ENV{ZEPHYR_BASE})
project(m5stack_core2_haptics)

target_sources(app PRIVATE 
    src/main.c
    src/haptics.c
)

# Add include directories
target_include_directories(app PRIVATE src)
```

## prj.conf
```kconfig
CONFIG_REGULATOR=y
CONFIG_I2C=y
CONFIG_GPIO=y

CONFIG_ESP32_USE_UNSUPPORTED_REVISION=y
```

## src/main.c
```c
#include <zephyr/kernel.h>
#include <zephyr/sys/printk.h>
#include "haptics.h"

int main(void)
{
    printk("M5Stack Core2 Haptics Test\n");

    haptics_init();

    haptics_start_strength(1);  /* Start at low strength */
    
    /* Gradually increase strength */
    for (int runs = 0; runs < 5; runs ++) {
        for (int strength = 1; strength <= 100; strength += 1) {
            printk("  Changing to %d%% strength\n", strength);
            haptics_set_strength(strength);
            k_sleep(K_MSEC(10));
        }
    }
    
    printk("  Ramping down strength\n");
    for (int strength = 90; strength >= 10; strength -= 10) {
        haptics_set_strength(strength);
        k_sleep(K_MSEC(100));
    }
    
    haptics_stop();
    k_sleep(K_MSEC(500));
    
    printk("Test 3: Pulsing effect\n");
    haptics_start_strength(30);
    
    for (int pulse = 0; pulse < 5; pulse++) {
        haptics_set_strength(100);  /* Strong pulse */
        k_sleep(K_MSEC(100));
        haptics_set_strength(20);   /* Weak background */
        k_sleep(K_MSEC(200));
    }
    
    haptics_stop();
    
    printk("Haptics test completed\n");
    
    return 0;
}
```

## src/haptics.c
```c
#include <zephyr/kernel.h>
#include <zephyr/device.h>
#include <zephyr/devicetree.h>
#include <zephyr/drivers/regulator.h>
#include "haptics.h"

/* Get the vibration motor regulator device */
static const struct device *vib_regulator = DEVICE_DT_GET(DT_NODELABEL(vib_motor));

/* Track current state */
static bool haptics_enabled = false;

/* Voltage range for vibration motor (in microvolts) */
#define HAPTICS_MIN_VOLTAGE_UV  2000000  /* 2.0V - minimum for motor operation */
#define HAPTICS_MAX_VOLTAGE_UV  3000000  /* 3.0V - maximum safe voltage */
#define HAPTICS_DEFAULT_VOLTAGE_UV 2800000  /* 2.8V - default strength */

/* Helper function to calculate voltage from percentage */
static uint32_t strength_to_voltage(uint8_t strength_percent)
{
    if (strength_percent > 100) {
        strength_percent = 100;
    }
    
    uint32_t voltage_range = HAPTICS_MAX_VOLTAGE_UV - HAPTICS_MIN_VOLTAGE_UV;
    return HAPTICS_MIN_VOLTAGE_UV + (voltage_range * strength_percent) / 100;
}

int haptics_init(void)
{
    int ret;
    /* Check if the regulator device is ready */
    ret = device_is_ready(vib_regulator); 
    if (!ret) {
        printk("Vibration motor regulator device not ready\n");
        return ret;
    }
    
    /* Ensure vibration is initially off */
    regulator_disable(vib_regulator);
    haptics_enabled = false;
    return 0;
}

void haptics_start(void)
{
    /* Start with default strength */
    haptics_start_strength(100);
}

void haptics_start_strength(uint8_t strength_percent)
{
    if (!device_is_ready(vib_regulator)) {
        return;
    }
    
    if (strength_percent == 0) {
        haptics_stop();
        return;
    }
    
    /* Calculate and set the target voltage */
    uint32_t target_voltage = strength_to_voltage(strength_percent);
    regulator_set_voltage(vib_regulator, target_voltage, target_voltage);
    
    /* Enable the vibration motor regulator if not already enabled */
    if (!haptics_enabled) {
        regulator_enable(vib_regulator);
        haptics_enabled = true;
    }
}

void haptics_set_strength(uint8_t strength_percent)
{
    if (!device_is_ready(vib_regulator)) {
        return;
    }
    
    if (strength_percent == 0) {
        haptics_stop();
        return;
    }
    
    /* Only change voltage if motor is currently running */
    if (haptics_enabled) {
        uint32_t target_voltage = strength_to_voltage(strength_percent);
        regulator_set_voltage(vib_regulator, target_voltage, target_voltage);
    }
}

void haptics_stop(void)
{
    if (!device_is_ready(vib_regulator)) {
        return;
    }
    
    /* Disable the vibration motor regulator */
    regulator_disable(vib_regulator);
    haptics_enabled = false;
}
```

## src/haptics.h
```c
#ifndef HAPTICS_H_
#define HAPTICS_H_

/**
 * @brief Initialize the haptic feedback system
 * 
 * This function must be called before using haptics_start() or haptics_stop().
 * It initializes the vibration motor regulator.
 */
int haptics_init(void);

/**
 * @brief Start haptic feedback (vibration)
 * 
 * Enables the vibration motor at default strength. Can be called from any thread.
 */
void haptics_start(void);

/**
 * @brief Start haptic feedback with specified strength
 * 
 * Enables the vibration motor at specified strength level.
 * 
 * @param strength_percent Vibration strength as percentage (0-100)
 *                        0 = off, 100 = maximum strength
 */
void haptics_start_strength(uint8_t strength_percent);

/**
 * @brief Change vibration strength while motor is running
 * 
 * Adjusts the vibration strength without stopping the motor.
 * Motor must already be running (started with haptics_start* functions).
 * 
 * @param strength_percent New vibration strength as percentage (0-100)
 *                        0 = stop motor, 100 = maximum strength
 */
void haptics_set_strength(uint8_t strength_percent);

/**
 * @brief Stop haptic feedback (vibration)
 * 
 * Disables the vibration motor. Can be called from any thread.
 */
void haptics_stop(void);

#endif /* HAPTICS_H_ */
```
